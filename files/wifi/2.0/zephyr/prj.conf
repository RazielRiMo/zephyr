## CMakeLists.txt
```
# CMakeLists.txt
# Proyecto Zephyr RTOS: puente TCP/JSON (usando <data/json.h>) con CRC-16
# para ESP32. Arquitectura de 3 tareas: notificador TCP (rol de ISR),
# procesador RX (bloqueado en un semáforo binario) y emisor periódico de
# telemetría. El esquema JSON vive centralizado en json_schema.{c,h}.

cmake_minimum_required(VERSION 3.20.0)

find_package(Zephyr REQUIRED HINTS $ENV{ZEPHYR_BASE})
project(esp32_tcp_json_bridge)

target_sources(app PRIVATE
    src/main.c
    src/wifi_manager.c
    src/tcp_server.c
    src/rx_processor.c
    src/telemetry_tx.c
    src/json_schema.c
    src/json_protocol.c
    src/crc16.c
)

target_include_directories(app PRIVATE src)
```

## prj.conf
```kconfig
# prj.conf
# Configuración de Zephyr para el puente TCP/JSON entre la ESP32 y la PC.
#
# NOTA: el SSID, la contraseña, el puerto TCP y el período de telemetría
# YA NO se configuran aquí -- viven como #define en
# firmware_zephyr/src/network_config.h, tal como pidió el enunciado
# ("fácilmente manipulables desde un archivo de cabecera o el inicio del
# main"). Este archivo solo activa subsistemas del kernel/red, que sí
# pertenecen al sistema Kconfig de Zephyr.
#
# NOTA IMPORTANTE: los nombres exactos de algunas opciones del driver Wi-Fi
# de la ESP32 (p. ej. CONFIG_WIFI_ESP32) pueden variar levemente según la
# versión de Zephyr y del módulo HAL de Espressif que tengas instalado.
# Si `west build` reporta que una opción "no existe", ejecuta
# `west build -t menuconfig`, busca "ESP32" / "WIFI" y ajusta el nombre.

# --- Kernel / logging ---
CONFIG_MAIN_STACK_SIZE=4096
CONFIG_LOG=y
CONFIG_LOG_DEFAULT_LEVEL=3
CONFIG_PRINTK=y

# --- GPIO (LED de acción local) ---
CONFIG_GPIO=y

# --- Librería JSON integrada de Zephyr (<data/json.h>) ---
# Requisito del proyecto: codificar/decodificar JSON EXCLUSIVAMENTE con
# esta librería (nada de cJSON, nada de snprintf armando texto JSON a mano).
CONFIG_JSON_LIBRARY=y

# --- Red: base TCP/IP ---
CONFIG_NETWORKING=y
CONFIG_NET_IPV4=y
CONFIG_NET_IPV6=n
CONFIG_NET_TCP=y
CONFIG_NET_SOCKETS=y
CONFIG_NET_SOCKETS_POLL=y
CONFIG_NET_DHCPV4=y

# Buffers de red: las tramas de este proyecto son pequeñas (< 256 B), pero
# se deja margen para varios paquetes en vuelo.
CONFIG_NET_PKT_RX_COUNT=16
CONFIG_NET_PKT_TX_COUNT=16
CONFIG_NET_BUF_RX_COUNT=32
CONFIG_NET_BUF_TX_COUNT=32
CONFIG_NET_MAX_CONTEXTS=6

# --- Wi-Fi ---
CONFIG_WIFI=y
CONFIG_WIFI_ESP32=y
CONFIG_NET_L2_WIFI_MGMT=y
CONFIG_NET_MGMT=y
CONFIG_NET_MGMT_EVENT=y
CONFIG_NET_MGMT_EVENT_INFO=y

# Heap adicional que usan el driver Wi-Fi y la pila de red
CONFIG_HEAP_MEM_POOL_SIZE=65536
```

## src/main.c
```c
/*
 * main.c - Puente TCP/JSON entre una ESP32 (Zephyr RTOS) y una PC.
 * =================================================================
 *
 * Arquitectura de tareas (una vez conectada la Wi-Fi):
 *
 *   [tcp_server_thread]  --recv()-->  notify_data_available()
 *         |  (rol de "ISR": trabajo minimo + k_sem_give)         |
 *         v                                                       v
 *   tcp_server_rx_ready (semaforo binario) <---- k_sem_take ---- [rx_processor_thread_fn]
 *                                                                  |
 *                                                json.h: decodifica + valida CRC
 *                                                                  |
 *                                                                  v
 *                                                       apply_local_action()  (aqui, en main.c)
 *
 *   [telemetry_tx_thread_fn] --> arma objeto (json_schema.h) --> json.h
 *                                codifica (json_protocol.c) --> tcp_server_send()
 *
 * main() SOLO se encarga de: (1) inicializar el GPIO del LED, (2) conectar
 * la Wi-Fi, y (3) arrancar las tres tareas; luego retorna. Las tareas,
 * creadas con K_THREAD_DEFINE en sus respectivos módulos, siguen
 * ejecutándose de forma independiente (Zephyr no las "mata" porque
 * main() haya terminado).
 *
 * CONFIGURACIÓN: SSID, contraseña, puerto TCP y período de telemetría
 * viven en network_config.h (#define simples) -- no en Kconfig/prj.conf.
 */

#include <stdint.h>
#include <stdbool.h>

#include <zephyr/kernel.h>
#include <zephyr/logging/log.h>
#include <zephyr/sys/util.h>
#include <zephyr/devicetree.h>
#include <zephyr/drivers/gpio.h>

#include "network_config.h"
#include "wifi_manager.h"
#include "tcp_server.h"
#include "rx_processor.h"
#include "telemetry_tx.h"

LOG_MODULE_REGISTER(main, LOG_LEVEL_INF);

/* COMUNICACIÓN: DT_ALIAS(action_led) resuelve, en tiempo de COMPILACIÓN,
 * el nodo de devicetree con alias "action-led" definido en app.overlay.
 * GPIO_DT_SPEC_GET extrae de ahí el controlador GPIO + número de pin +
 * flags (GPIO_ACTIVE_HIGH) ya empaquetados en un struct gpio_dt_spec, sin
 * que este archivo necesite conocer el pin físico exacto (eso es
 * responsabilidad exclusiva de app.overlay -- así el LED es portable
 * entre placas distintas con solo editar el overlay). */
#define ACTION_LED_NODE DT_ALIAS(action_led)
static const struct gpio_dt_spec action_led = GPIO_DT_SPEC_GET(ACTION_LED_NODE, gpios);

/*
 * apply_local_action() -- la "acción local" que pide el enunciado al
 * recibir un valor numérico válido desde la PC.
 *
 * POR QUÉ vive en main.c y no en rx_processor.c: rx_processor.c conoce el
 * PROTOCOLO (CRC, JSON) pero no debería conocer QUÉ HACE la aplicación
 * con un valor válido -- esa es una decisión de la aplicación final
 * (main.c), no del pipeline de comunicación. Por eso se pasa como
 * callback (function pointer) a rx_processor_start(), en vez de que
 * rx_processor.c la llame por nombre directamente.
 *
 * COMUNICACIÓN: se ejecuta en el CONTEXTO DE LA TAREA DE PROCESAMIENTO
 * (rx_processor.c), nunca en el hilo notificador de tcp_server.c -- por
 * eso puede tardar unos milisegundos (parpadear un LED) sin afectar la
 * atención al socket.
 */
static void apply_local_action(int value, bool has_value)
{
	if (!has_value) {
		LOG_WRN("Trama valida pero sin campo \"value\": no hay accion que ejecutar");
		return;
	}

	/* PARÁMETRO CLAMP(value, 0, 20): acota el numero de parpadeos por
	 * seguridad/tiempo de respuesta -- un valor grande (o negativo,
	 * enviado por error desde la GUI) no debe trabar esta tarea durante
	 * mucho tiempo ni ejecutar un bucle con conteo negativo. */
	int blinks = CLAMP(value, 0, 20);

	LOG_INF("Ejecutando accion local: %d parpadeo(s) del LED (value recibido=%d)",
		blinks, value);

	for (int i = 0; i < blinks; i++) {
		/* PARÁMETRO 120 ms por semiperiodo: suficientemente lento
		 * para que el parpadeo sea visible a simple vista, sin
		 * alargar demasiado la ejecucion total del callback. */
		gpio_pin_set_dt(&action_led, 1);
		k_msleep(120);
		gpio_pin_set_dt(&action_led, 0);
		k_msleep(120);
	}
}

int main(void)
{
	LOG_INF("=== Puente TCP/JSON ESP32 <-> PC (Zephyr RTOS) ===");
	/* Se loguea el SSID configurado para que, si la conexion Wi-Fi
	 * falla, sea evidente desde el primer mensaje QUE credenciales
	 * (network_config.h) esta usando el firmware realmente compilado. */
	LOG_INF("SSID configurado: \"%s\" (edita WIFI_SSID en network_config.h para cambiarlo)",
		WIFI_SSID);

	/* PARÁMETRO GPIO_OUTPUT_INACTIVE: configura el pin como SALIDA y en
	 * estado inicial "inactivo" (apagado, considerando GPIO_ACTIVE_HIGH
	 * definido en app.overlay) -- evita que el LED quede encendido por
	 * defecto antes de la primera accion local. */
	if (!gpio_is_ready_dt(&action_led)) {
		LOG_ERR("El GPIO del LED de accion no esta listo (revisa app.overlay)");
	} else {
		gpio_pin_configure_dt(&action_led, GPIO_OUTPUT_INACTIVE);
	}

	/* COMUNICACIÓN: bloquea aquí hasta que wifi_manager.c confirme IP
	 * (o falle). Es una decisión de diseño deliberada: no tiene sentido
	 * arrancar las tareas de red (tcp_server, rx_processor,
	 * telemetry_tx) si todavía no hay una interfaz de red utilizable. */
	int ret = wifi_manager_connect();

	if (ret != 0) {
		LOG_ERR("No fue posible conectar a la red Wi-Fi (err=%d). Deteniendo.", ret);
		return ret;
	}

	/* Arranque de las 3 tareas. El orden entre rx_processor_start() y
	 * tcp_server_start() no es estrictamente crítico gracias a
	 * K_SEM_DEFINE/K_MUTEX_DEFINE (el semáforo y los mutex de
	 * tcp_server.c ya existen, inicializados en 0, desde ANTES de que
	 * main() empiece a correr) -- pero arrancar primero a quien va a
	 * ESCUCHAR el semáforo dejar el flujo de arranque más fácil de
	 * leer. telemetry_tx_start() se deja al final porque es la única de
	 * las tres que no tiene nada que "esperar": simplemente empieza su
	 * bucle periódico. */
	rx_processor_start(apply_local_action);
	tcp_server_start();
	telemetry_tx_start();

	LOG_INF("Sistema listo: 3 tareas activas "
		"(notificador TCP tipo ISR, procesador RX por semaforo, emisor de telemetria)");

	return 0;
}
```

## src/crc16.c
```c
#include "crc16.h"

uint16_t crc16_ccitt_false(const uint8_t *data, size_t len)
{
	/* Semilla inicial 0xFFFF: parte fija del algoritmo CRC-16/CCITT-FALSE
	 * (no es arbitraria -- cambiar este valor da un CRC de una variante
	 * DISTINTA, incompatible con protocol.py). */
	uint16_t crc = 0xFFFF;

	for (size_t i = 0; i < len; i++) {
		/* Mezcla el byte actual en los 8 bits altos del registro de
		 * CRC. Es el punto donde cada byte del mensaje "entra" al
		 * cálculo. */
		crc ^= (uint16_t)data[i] << 8;

		/* Procesa el byte bit a bit (MSB primero, por eso "sin
		 * reflejar"): 8 iteraciones porque un byte tiene 8 bits. */
		for (int bit = 0; bit < 8; bit++) {
			if (crc & 0x8000) {
				/* Si el bit más significativo es 1, se
				 * desplaza y se aplica XOR con el polinomio
				 * generador 0x1021 (x^16+x^12+x^5+1 en
				 * notación polinómica) -- este es el corazón
				 * matemático del CRC-CCITT. */
				crc = (uint16_t)((crc << 1) ^ 0x1021);
			} else {
				crc = (uint16_t)(crc << 1);
			}
		}
	}

	return crc;
}
```

## src/crc16.h
```c
#ifndef CRC16_H_
#define CRC16_H_

#include <stddef.h>
#include <stdint.h>

/*
 * crc16.h / crc16.c
 * ==================
 * POR QUÉ: es el mecanismo de detección de integridad que exige el
 * enunciado. Cada trama JSON (en ambas direcciones) viaja acompañada de
 * un CRC-16 calculado sobre sus bytes de datos; si esos bytes se alteran
 * en tránsito (ruido de red, trama recortada, etc.), el CRC recalculado
 * en el receptor no coincidirá con el recibido, y eso es lo que dispara
 * el conteo de errores y el aviso por consola/serial.
 *
 * CON QUÉ se comunica: no depende de sockets, hilos ni JSON -- es una
 * función matemática pura (bytes de entrada -> entero de 16 bits). La usa
 * json_protocol.c, tanto al construir tramas salientes (telemetry_tx.c)
 * como al verificar tramas entrantes (rx_processor.c).
 */

/**
 * @brief Calcula el CRC-16/CCITT-FALSE de un bloque de datos.
 *
 * Implementación manual, bit a bit (no depende de zephyr/sys/crc.h), para
 * poder documentar y replicar EXACTAMENTE el mismo algoritmo en el lado
 * PC (ver protocol.py) sin ambigüedad sobre qué variante de "CRC-16" se
 * está usando (existen muchas: CCITT, XMODEM, MODBUS, etc., cada una con
 * distinto polinomio/semilla/reflejo).
 *
 * Parámetros fijos del algoritmo (deben coincidir en C y en Python):
 *   - Polinomio:       0x1021
 *   - Valor inicial:   0xFFFF
 *   - Reflejado (in):  No
 *   - Reflejado (out): No
 *   - XOR de salida:   0x0000
 *
 * Vector de prueba estándar para validar cualquier reimplementación:
 *   crc16_ccitt_false((uint8_t *)"123456789", 9) == 0x29B1
 *
 * @param data PARÁMETRO: puntero al primer byte a proteger. Es
 *             "const uint8_t *" (no "char *") para dejar explícito que la
 *             función trata la entrada como bytes crudos, no como texto.
 * @param len  PARÁMETRO: cuántos bytes de 'data' incluir en el cálculo.
 *             Se pasa explícito (en vez de asumir una cadena terminada en
 *             '\0') porque el buffer JSON ya codificado por
 *             json_obj_encode_buf() SÍ está NUL-terminado, pero mantener
 *             'len' explícito hace la función reutilizable también sobre
 *             datos binarios sin terminador.
 * @return Valor de 16 bits del CRC calculado.
 */
uint16_t crc16_ccitt_false(const uint8_t *data, size_t len);

#endif /* CRC16_H_ */
```

## src/json_protocol.c
```c
#include <string.h>
#include <stdio.h>
#include <stdlib.h>

#include <zephyr/data/json.h>
#include <zephyr/sys/util.h>

#include "json_protocol.h"
#include "json_schema.h"
#include "crc16.h"

/* Buffer intermedio para la codificación "solo payload" (sin "crc"), tanto
 * al construir telemetría como al re-codificar un comando para verificar
 * su CRC. 160 B alcanza de sobra para los campos de este esquema; si el
 * esquema crece, agranda esta cota junto con JSON_FRAME_MAX_LEN. */
#define PAYLOAD_BUF_LEN 160

int json_protocol_build_telemetry(char *out, size_t out_size,
				   uint32_t seq, uint32_t uptime_ms,
				   int value, uint32_t esp32_crc_errors)
{
	/* PASO 1 -- Codificar SOLO los datos (sin "crc") con <data/json.h>.
	 *
	 * POR QUÉ: para calcular un CRC que el receptor pueda reproducir,
	 * necesitamos los bytes EXACTOS de "los datos sin el crc". La única
	 * forma de tener esos bytes con certeza es pedírselos a la misma
	 * librería que los va a generar de verdad (json_obj_encode_buf),
	 * en vez de intentar adivinarlos con snprintf.
	 *
	 * COMUNICACIÓN: usa telemetry_payload_descr (json_schema.c), que
	 * describe los primeros 5 campos de struct telemetry_payload.
	 *
	 * PARÁMETROS de json_obj_encode_buf(descr, descr_len, val, buf, buf_size):
	 *   - descr/descr_len: el "mapa" de qué campos de 'val' escribir y
	 *     en qué orden (el orden del arreglo = el orden en el JSON).
	 *   - val: puntero al struct con los datos reales de ESTE ciclo.
	 *   - buf/buf_size: destino; la función devuelve error (no escribe
	 *     de más) si payload_buf fuera demasiado chico.
	 */
	struct telemetry_payload payload = {
		.type = "telemetry",
		.seq = (int)seq,
		.uptime_ms = (int)uptime_ms,
		.value = value,
		.esp32_crc_errors = (int)esp32_crc_errors,
	};
	char payload_buf[PAYLOAD_BUF_LEN];

	int ret = json_obj_encode_buf(telemetry_payload_descr, telemetry_payload_descr_len,
				       &payload, payload_buf, sizeof(payload_buf));
	if (ret != 0) {
		return -1;
	}

	/* PASO 2 -- CRC-16 sobre esos bytes exactos.
	 * PARÁMETRO len: strlen(payload_buf) es válido porque
	 * json_obj_encode_buf() deja el resultado como cadena C
	 * NUL-terminada (no un buffer binario de longitud separada). */
	uint16_t crc = crc16_ccitt_false((const uint8_t *)payload_buf, strlen(payload_buf));

	/* PASO 3 -- Formatear el CRC como texto hex de 4 dígitos.
	 *
	 * ACLARACIÓN IMPORTANTE: este snprintf() NO construye JSON (no hay
	 * '{', '}', ':' ni ',' en el formato "%04X") -- solo convierte un
	 * entero de 16 bits a su representación hexadecimal de ancho fijo,
	 * para guardarla en un campo de tipo string. Es una conversión de
	 * VALOR, no un armado de estructura JSON a mano; el objeto JSON en
	 * sí lo sigue generando exclusivamente json_obj_encode_buf() en el
	 * paso 4. */
	char crc_str[5];

	snprintf(crc_str, sizeof(crc_str), "%04X", crc);

	/* PASO 4 -- Codificar el frame COMPLETO (payload + crc) con
	 * <data/json.h>: esta es la trama que realmente sale por el socket.
	 * COMUNICACIÓN: usa telemetry_frame_descr, que agrega el campo
	 * "crc" (JSON_TOK_STRING) al final del mismo conjunto de campos. */
	struct telemetry_frame frame = {
		.type = payload.type,
		.seq = payload.seq,
		.uptime_ms = payload.uptime_ms,
		.value = payload.value,
		.esp32_crc_errors = payload.esp32_crc_errors,
		.crc = crc_str,
	};

	ret = json_obj_encode_buf(telemetry_frame_descr, telemetry_frame_descr_len,
				   &frame, out, out_size);
	if (ret != 0) {
		return -1;
	}

	size_t len = strlen(out);

	/* Framing por línea: TCP es un flujo de bytes SIN límites de mensaje
	 * propios (dos tramas seguidas podrían llegar "pegadas" al otro
	 * lado). Se añade '\n' como delimitador de TRANSPORTE -- no es
	 * contenido JSON, por eso se agrega DESPUÉS de que json_obj_encode_buf
	 * terminó, nunca dentro del objeto codificado. */
	if (len + 1 >= out_size) {
		return -1;
	}
	out[len] = '\n';
	out[len + 1] = '\0';

	return (int)(len + 1);
}

void json_protocol_decode_command(char *raw, size_t len, struct json_command_result *result)
{
	memset(result, 0, sizeof(*result));

	/* PASO 1 -- Decodificar el frame COMPLETO (cmd + value + crc) con
	 * <data/json.h>.
	 *
	 * POR QUÉ "raw" no es const: json_obj_parse() decodifica IN PLACE.
	 * Para cada campo JSON_TOK_STRING, sustituye la comilla de cierre
	 * por '\0' y deja el puntero correspondiente (frame.cmd, frame.crc)
	 * apuntando DENTRO de 'raw'. Esto evita copiar memoria (importante
	 * en un microcontrolador), pero significa que frame.cmd/frame.crc
	 * SOLO son válidos mientras 'raw' siga vivo y sin sobrescribir --
	 * por eso se usan y se descartan dentro de esta misma función,
	 * antes de que rx_processor.c reutilice ese buffer para la próxima
	 * trama.
	 *
	 * PARÁMETROS de json_obj_parse(json, len, descr, descr_len, val):
	 *   - json/len: EXACTAMENTE los bytes de un objeto JSON (sin '\n'
	 *     final); rx_processor.c ya se encarga de pasar la línea
	 *     recortada en el '\n'.
	 *   - descr/descr_len: command_frame_descr, que espera 3 campos:
	 *     cmd (string), value (número), crc (string).
	 *   - val: dónde escribir los punteros/enteros decodificados.
	 *
	 * VALOR DE RETORNO: no es un simple 0/-1. Si el texto no es JSON
	 * válido, devuelve un código negativo. Si es válido, devuelve una
	 * MÁSCARA DE BITS: el bit N indica que el campo descr[N] fue
	 * encontrado. Con 3 campos, "los 3 presentes" es
	 * BIT(0)|BIT(1)|BIT(2) -- por eso se compara contra esa máscara en
	 * vez de solo comprobar "ret >= 0" (un JSON válido pero incompleto,
	 * p. ej. sin "crc", NO debe tratarse como éxito). */
	struct command_frame frame = {0};

	int parsed_mask = json_obj_parse(raw, len, command_frame_descr,
					  command_frame_descr_len, &frame);
	const int expected_mask = BIT(0) | BIT(1) | BIT(2);

	if (parsed_mask < 0 || (parsed_mask & expected_mask) != expected_mask) {
		result->format_ok = false;
		return;
	}
	result->format_ok = true;

	/* PASO 2 -- Re-codificar SOLO cmd+value (sin "crc") para reproducir
	 * los bytes sobre los que el EMISOR debió calcular el CRC.
	 *
	 * POR QUÉ este paso, en vez de "recortar" el texto crudo a mano:
	 * mantiene TODO el manejo de JSON dentro de <data/json.h> (el
	 * enunciado prohíbe construir/parsear JSON a mano). Como
	 * command_payload_descr describe los MISMOS 2 primeros campos, en
	 * el MISMO orden que usó el emisor (ver protocol.py en la PC), el
	 * resultado de esta re-codificación es byte-a-byte idéntico al que
	 * produjo el emisor -- siempre que ambos lados usen separadores
	 * compactos (ver la nota sobre esto en protocol.py).
	 *
	 * COMUNICACIÓN: payload.cmd apunta al mismo texto que frame.cmd
	 * (dentro de 'raw'); es un simple alias de puntero, no una copia. */
	struct command_payload payload = {
		.cmd = frame.cmd,
		.value = frame.value,
	};
	char verify_buf[PAYLOAD_BUF_LEN];

	int ret = json_obj_encode_buf(command_payload_descr, command_payload_descr_len,
				       &payload, verify_buf, sizeof(verify_buf));
	if (ret != 0) {
		result->format_ok = false;
		return;
	}

	/* PASO 3 -- Comparar el CRC calculado localmente contra el recibido. */
	result->crc_computed = crc16_ccitt_false((const uint8_t *)verify_buf, strlen(verify_buf));
	/* PARÁMETRO base 16: frame.crc es texto hexadecimal ("7A3F"), tal
	 * como lo produce "%04X" del lado emisor (ver json_protocol_build_telemetry
	 * y protocol.py). strtoul con NULL como segundo argumento indica
	 * "no necesito saber dónde terminó de leer". */
	result->crc_received = (uint16_t)strtoul(frame.crc, NULL, 16);
	result->crc_ok = (result->crc_computed == result->crc_received);

	result->value = frame.value;
	result->has_value = true; /* 'value' es un campo obligatorio de este esquema */
}
```

## src/json_protocol.h
```c
#ifndef JSON_PROTOCOL_H_
#define JSON_PROTOCOL_H_

#include <stddef.h>
#include <stdint.h>
#include <stdbool.h>

/*
 * json_protocol.h / json_protocol.c
 * ===================================
 * POR QUÉ: separa la LÓGICA de "cómo se firma y verifica una trama con
 * CRC" (que es siempre el mismo patrón, sin importar los campos) del
 * ESQUEMA de cada trama (que vive en json_schema.h/c). tcp_server.c,
 * rx_processor.c y telemetry_tx.c llaman a las dos funciones de abajo y
 * no necesitan saber NADA sobre JSON_OBJ_DESCR_PRIM, json_obj_parse, ni
 * los nombres de los campos: eso es exactamente lo que pide el enunciado
 * al hablar de "sin alterar la lógica central de red, hilos o
 * interrupciones" cuando se modifique el esquema.
 *
 * Patrón usado en ambas funciones (encoding y decoding), explicado una
 * sola vez aquí para no repetirlo en cada comentario de json_protocol.c:
 *   1. Se codifica/decodifica el "payload" (los campos SIN "crc") usando
 *      <data/json.h>.
 *   2. Se calcula CRC-16 sobre los bytes EXACTOS que produjo/produciría
 *      esa codificación (nunca sobre una reconstrucción manual).
 *   3. Se compara (al decodificar) o se agrega (al codificar) el campo
 *      "crc", también a través de <data/json.h>.
 */

/* Cota superior razonable para una trama de este protocolo (campos cortos,
 * sin arreglos ni objetos anidados): deja margen de sobra y evita reservar
 * buffers grandes en la pila de tareas con stacks acotados. */
#define JSON_FRAME_MAX_LEN 256

/** Resultado de decodificar y verificar una trama de comando entrante. */
struct json_command_result {
	bool format_ok;       /* true si el JSON tenía los 3 campos esperados (cmd, value, crc) */
	bool crc_ok;           /* true si crc_computed == crc_received */
	uint16_t crc_received;
	uint16_t crc_computed;
	bool has_value;         /* true si 'value' se pudo extraer (implica format_ok) */
	int value;
};

/**
 * @brief Construye una trama de telemetría (payload + CRC) codificada
 *        íntegramente con <data/json.h>, lista para enviar por el socket
 *        (incluye el '\n' final de framing).
 *
 * COMUNICACIÓN: la usa telemetry_tx.c, una vez por ciclo de su tarea
 * periódica. El resultado se pasa a tcp_server_send().
 *
 * PARÁMETROS:
 * @param out    Buffer de salida donde se escribe la trama completa.
 * @param out_size Tamaño de 'out'; debe ser >= JSON_FRAME_MAX_LEN para
 *               tener margen (ver el mismo #define en este header).
 * @param seq    Número de secuencia (telemetry_tx.c lleva la cuenta).
 * @param uptime_ms Milisegundos desde el arranque (k_uptime_get() en el
 *               llamador); se pasa como parámetro en vez de llamarlo aquí
 *               para mantener esta función independiente del reloj del
 *               sistema (más fácil de probar/reutilizar).
 * @param value  Dato simulado (o, en un proyecto real, una lectura de
 *               sensor) que cambia en cada llamada.
 * @param esp32_crc_errors Contador actual de errores de CRC del lado
 *               ESP32 (rx_processor_get_crc_error_count()), para que la
 *               PC también lo vea.
 * @return Longitud de la trama escrita en 'out' (bytes, incluye '\n'), o
 *         un valor negativo si algo falló (p. ej. buffer insuficiente).
 */
int json_protocol_build_telemetry(char *out, size_t out_size,
				   uint32_t seq, uint32_t uptime_ms,
				   int value, uint32_t esp32_crc_errors);

/**
 * @brief Decodifica una trama de comando y verifica su CRC, ambos pasos
 *        usando exclusivamente <data/json.h>.
 *
 * COMUNICACIÓN: la usa rx_processor.c, una vez por cada línea completa
 * ('\n'-terminada) que llega al buffer que tcp_server.c fue llenando.
 *
 * PARÁMETROS:
 * @param raw NO es "const": <data/json.h> decodifica IN PLACE (reemplaza
 *            comillas de cierre de cada string por '\0' para poder
 *            devolver punteros "const char *" que apuntan DENTRO de este
 *            mismo buffer, sin copiar memoria). Por eso el buffer debe
 *            seguir vivo mientras 'raw' se está procesando, y por eso
 *            esta función NO debe recibir un literal de cadena.
 * @param len  Cantidad de bytes de 'raw' a interpretar como UN objeto
 *             JSON (sin incluir el '\n' delimitador de trama).
 * @param result Resultado: qué se decodificó y si el CRC coincidió.
 */
void json_protocol_decode_command(char *raw, size_t len,
				   struct json_command_result *result);

#endif /* JSON_PROTOCOL_H_ */
```

## src/json_schema.c
```c
#include "json_schema.h"

/*
 * Cada línea de un descriptor es UN campo del JSON. JSON_OBJ_DESCR_PRIM
 * recibe (struct, nombre_del_campo_en_el_struct, tipo_de_token):
 *   - El nombre del campo del struct se usa TAMBIÉN como nombre de la
 *     clave JSON (por eso los structs en json_schema.h usan como nombre
 *     de miembro exactamente la clave que se quiere en el JSON, p. ej.
 *     "uptime_ms" produce la clave "uptime_ms").
 *   - JSON_TOK_STRING  -> el campo debe ser "const char *".
 *   - JSON_TOK_NUMBER  -> el campo debe ser un entero (aquí, "int").
 * La MACRO usa internamente offsetof()/sizeof() sobre el struct indicado,
 * así que un error de tipo (p. ej. usar JSON_TOK_NUMBER sobre un "const
 * char *") se detecta en tiempo de COMPILACIÓN, no en tiempo de ejecución.
 */

/* ---- Telemetría (ESP32 -> PC) ---- */

const struct json_obj_descr telemetry_payload_descr[] = {
	JSON_OBJ_DESCR_PRIM(struct telemetry_payload, type, JSON_TOK_STRING),
	JSON_OBJ_DESCR_PRIM(struct telemetry_payload, seq, JSON_TOK_NUMBER),
	JSON_OBJ_DESCR_PRIM(struct telemetry_payload, uptime_ms, JSON_TOK_NUMBER),
	JSON_OBJ_DESCR_PRIM(struct telemetry_payload, value, JSON_TOK_NUMBER),
	JSON_OBJ_DESCR_PRIM(struct telemetry_payload, esp32_crc_errors, JSON_TOK_NUMBER),
};
/* PARÁMETRO: se exporta la CANTIDAD de entradas (no solo el arreglo)
 * porque un "extern struct json_obj_descr arr[];" en otro archivo NO
 * conserva el tamaño del arreglo (queda como tipo incompleto): cualquier
 * módulo que quiera usar ARRAY_SIZE() sobre este descriptor desde fuera
 * de este archivo necesita este valor ya calculado aquí, donde el
 * arreglo SÍ tiene tamaño conocido en tiempo de compilación. */
const size_t telemetry_payload_descr_len = ARRAY_SIZE(telemetry_payload_descr);

const struct json_obj_descr telemetry_frame_descr[] = {
	JSON_OBJ_DESCR_PRIM(struct telemetry_frame, type, JSON_TOK_STRING),
	JSON_OBJ_DESCR_PRIM(struct telemetry_frame, seq, JSON_TOK_NUMBER),
	JSON_OBJ_DESCR_PRIM(struct telemetry_frame, uptime_ms, JSON_TOK_NUMBER),
	JSON_OBJ_DESCR_PRIM(struct telemetry_frame, value, JSON_TOK_NUMBER),
	JSON_OBJ_DESCR_PRIM(struct telemetry_frame, esp32_crc_errors, JSON_TOK_NUMBER),
	JSON_OBJ_DESCR_PRIM(struct telemetry_frame, crc, JSON_TOK_STRING),
};
const size_t telemetry_frame_descr_len = ARRAY_SIZE(telemetry_frame_descr);

/* ---- Comando (PC -> ESP32) ---- */

const struct json_obj_descr command_payload_descr[] = {
	JSON_OBJ_DESCR_PRIM(struct command_payload, cmd, JSON_TOK_STRING),
	JSON_OBJ_DESCR_PRIM(struct command_payload, value, JSON_TOK_NUMBER),
};
const size_t command_payload_descr_len = ARRAY_SIZE(command_payload_descr);

const struct json_obj_descr command_frame_descr[] = {
	JSON_OBJ_DESCR_PRIM(struct command_frame, cmd, JSON_TOK_STRING),
	JSON_OBJ_DESCR_PRIM(struct command_frame, value, JSON_TOK_NUMBER),
	JSON_OBJ_DESCR_PRIM(struct command_frame, crc, JSON_TOK_STRING),
};
const size_t command_frame_descr_len = ARRAY_SIZE(command_frame_descr);
```

## src/json_schema.h
```c
#ifndef JSON_SCHEMA_H_
#define JSON_SCHEMA_H_

#include <zephyr/data/json.h>

/*
 * json_schema.h / json_schema.c
 * ==============================
 * POR QUÉ este archivo existe (requisito de diseño "modular y
 * reutilizable" del enunciado): es el ÚNICO lugar del proyecto donde se
 * describe "de qué campos se compone cada trama JSON". Toda la lógica de
 * red, hilos, semáforos e interrupciones (tcp_server.c, rx_processor.c,
 * telemetry_tx.c) NO conoce estos campos uno por uno: solo le pasa a
 * json_protocol.c un puntero a un struct + su descriptor. Para agregar,
 * quitar o renombrar un campo en un futuro proyecto, basta con:
 *   1. Editar el struct correspondiente aquí abajo.
 *   2. Editar su `struct json_obj_descr[]` correspondiente en
 *      json_schema.c (una línea JSON_OBJ_DESCR_PRIM por campo).
 * Ningún otro archivo necesita cambiar.
 *
 * CON QUÉ se comunica: <zephyr/data/json.h> es la librería INTEGRADA de
 * Zephyr para codificar/decodificar JSON a partir de descriptores
 * estáticos (JSON_OBJ_DESCR_PRIM) en vez de parsers genéricos -- ideal
 * para microcontroladores porque no reserva memoria dinámica y valida el
 * esquema en tiempo de compilación (los descriptores usan offsetof()).
 * Está prohibido usar cJSON u otra librería externa; este archivo es la
 * prueba de que todo el manejo de JSON pasa por json.h.
 *
 * Patrón "payload" vs "frame" (se repite para cada tipo de trama):
 *   - *_payload: SOLO los campos de datos, SIN "crc". Se usa para
 *     calcular el CRC sobre bytes 100% controlados por json.h.
 *   - *_frame:   los mismos campos MÁS "crc". Es lo que realmente viaja
 *     por el socket. Ver json_protocol.c para el porqué de esta división.
 */

/* ---------- Telemetría: la ESP32 la ENVÍA a la PC ---------- */

/* PARÁMETROS de cada campo (por qué existe, qué representa):
 *   type              -- string fijo "telemetry": permite a la PC (o a un
 *                         futuro tercer tipo de trama) distinguir el
 *                         propósito del mensaje solo con leer un campo.
 *   seq               -- contador incremental: útil para detectar tramas
 *                         perdidas o reordenadas en la GUI.
 *   uptime_ms         -- k_uptime_get() de la ESP32: referencia temporal
 *                         simple sin depender de RTC.
 *   value             -- dato "simulado" que cambia cada ciclo (ver
 *                         telemetry_tx.c): es justamente lo que hace que
 *                         el CRC sea distinto en cada trama.
 *   esp32_crc_errors  -- contador de errores de CRC del LADO ESP32 (tramas
 *                         de comando recibidas con CRC inválido), para que
 *                         la GUI de Python también pueda mostrarlo.
 */
struct telemetry_payload {
	const char *type;
	int seq;
	int uptime_ms;
	int value;
	int esp32_crc_errors;
};

/* Igual que telemetry_payload, más el campo "crc" (string de 4 hex).
 * PARÁMETRO crc: se decodifica/codifica como JSON_TOK_STRING (no como
 * número) para conservar ceros a la izquierda (p. ej. "003F"), que se
 * perderían si se guardara como entero. */
struct telemetry_frame {
	const char *type;
	int seq;
	int uptime_ms;
	int value;
	int esp32_crc_errors;
	const char *crc;
};

extern const struct json_obj_descr telemetry_payload_descr[];
extern const size_t telemetry_payload_descr_len;
extern const struct json_obj_descr telemetry_frame_descr[];
extern const size_t telemetry_frame_descr_len;

/* ---------- Comando: la PC lo ENVÍA a la ESP32 ---------- */

/* PARÁMETROS:
 *   cmd   -- string fijo "set_value": identifica la intención del mensaje
 *            (deja espacio para agregar más "cmd" en el futuro sin romper
 *            el esquema, p. ej. "set_pwm", "reset_counters", ...).
 *   value -- entero que el usuario escribió en el campo de texto de la
 *            GUI de Tkinter; es el dato que dispara apply_local_action().
 */
struct command_payload {
	const char *cmd;
	int value;
};

struct command_frame {
	const char *cmd;
	int value;
	const char *crc;
};

extern const struct json_obj_descr command_payload_descr[];
extern const size_t command_payload_descr_len;
extern const struct json_obj_descr command_frame_descr[];
extern const size_t command_frame_descr_len;

#endif /* JSON_SCHEMA_H_ */
```

## src/network_config.h
```c
#ifndef NETWORK_CONFIG_H_
#define NETWORK_CONFIG_H_

/*
 * network_config.h
 * =================
 * POR QUÉ este archivo existe: agrupa en un único lugar, con nombres
 * simples de encontrar, los valores que alguien SIN experiencia en Zephyr
 * necesita tocar para adaptar el proyecto a su propia red (SSID,
 * contraseña, puerto). Antes estos valores vivían en Kconfig/prj.conf,
 * lo que obliga a conocer el sistema de configuración de Zephyr; ahora
 * basta con editar las 4 líneas de abajo y recompilar. main.c incluye
 * este header directamente, y wifi_manager.c / tcp_server.c / 
 * telemetry_tx.c hacen lo mismo para leer estas mismas constantes: es
 * la "biblioteca asignada" a la configuración de red del proyecto.
 *
 * CON QUÉ se comunica: estos valores se usan al construir los parámetros
 * de conexión Wi-Fi (wifi_manager.c -> net_mgmt/NET_REQUEST_WIFI_CONNECT),
 * al abrir el socket servidor (tcp_server.c -> bind()) y al fijar el
 * período del bucle de la tarea de telemetría (telemetry_tx.c -> k_msleep()).
 */

/* SSID (nombre) de la red Wi-Fi 2.4 GHz a la que se conectará la ESP32.
 * PARÁMETRO: es un string, porque así lo exige wifi_connect_req_params.ssid
 * (arreglo de bytes + longitud). Reemplázalo por el SSID real de tu router. */
#define WIFI_SSID       "MI_RED_WIFI"

/* Contraseña (PSK) de la red Wi-Fi. PARÁMETRO: string en texto plano
 * porque wifi_connect_req_params.psk espera la passphrase WPA2 sin
 * procesar (Zephyr deriva la clave real internamente). Evita dejar
 * credenciales reales en un repositorio versionado. */
#define WIFI_PASSWORD   "MI_CONTRASENA"

/* Puerto TCP en el que la ESP32 escucha como SERVIDOR. PARÁMETRO: 5000
 * es un puerto alto, fuera del rango "well-known" (0-1023), por lo que
 * no requiere privilegios especiales y es poco probable que choque con
 * otro servicio. Debe coincidir con el puerto que uses al ejecutar
 * pc_client/main.py en la PC. */
#define TCP_SERVER_PORT 5000

/* Período (en milisegundos) de la tarea periódica de telemetría.
 * PARÁMETRO: 2000 ms es un valor cómodo para observar cambios en la GUI
 * de Python a simple vista sin saturar la red ni el log serial; bájalo
 * para más frecuencia de muestreo, súbelo para reducir tráfico. */
#define TELEMETRY_PERIOD_MS 2000

#endif /* NETWORK_CONFIG_H_ */
```

## src/rx_processor.c
```c
/*
 * rx_processor.c
 * ================
 * POR QUÉ este módulo existe: es la "tarea de procesamiento específica"
 * que pide el enunciado. Pasa casi todo su tiempo BLOQUEADA en
 * k_sem_take(&tcp_server_rx_ready, K_FOREVER) — el semáforo binario que
 * tcp_server.c libera al recibir datos (ver el comentario de diseño en
 * ese archivo, que explica por qué ese hilo hace de "ISR de aplicación").
 *
 * Al despertar, este módulo:
 *   1. Drena TODOS los bytes pendientes del buffer de tcp_server.c
 *      (tcp_server_drain_rx), en un bucle propio (por si llegó más de una
 *      ráfaga desde la última señal: un semáforo binario no cuenta
 *      eventos, solo indica "hay trabajo pendiente").
 *   2. Reensambla tramas completas delimitadas por '\n' en un buffer
 *      local (TCP es un flujo de bytes: una trama puede llegar partida en
 *      varios recv(), o varias tramas pueden llegar juntas).
 *   3. Para cada trama completa: decodifica y valida su CRC-16 llamando a
 *      json_protocol_decode_command() (que usa <data/json.h>, nunca
 *      parsing manual). Si falla, imprime un mensaje de error detallado y
 *      aumenta el contador local de errores. Si es válida, extrae
 *      "value" y llama al callback de acción local.
 *
 * CON QUÉ se comunica: tcp_server.c (semáforo + drenado del buffer),
 * json_protocol.c (decodificación/verificación) y, vía el callback
 * registrado en rx_processor_start(), con main.c (acción local sobre el
 * LED).
 */

#include <string.h>

#include <zephyr/kernel.h>
#include <zephyr/logging/log.h>

#include "rx_processor.h"
#include "tcp_server.h"
#include "json_protocol.h"

LOG_MODULE_REGISTER(rx_processor, LOG_LEVEL_INF);

/* PARÁMETROS de hilo: mismo tamaño/prioridad que tcp_server.c (ver la
 * justificación detallada en ese archivo) -- aquí el mayor consumo de
 * pila no es la red sino json_obj_parse()/json_obj_encode_buf() operando
 * sobre buffers locales de hasta JSON_FRAME_MAX_LEN bytes. */
#define RX_PROCESSOR_STACK_SIZE 4096
#define RX_PROCESSOR_PRIORITY   5

/* PARÁMETRO ACCUM_BUF_SIZE: buffer de reensamblado de esta tarea. Se usa
 * JSON_FRAME_MAX_LEN (definido en json_protocol.h) para que el límite de
 * "cuánto puede crecer una trama antes de considerarse un error" esté
 * definido en UN solo lugar, coherente con el resto del protocolo. */
#define ACCUM_BUF_SIZE          JSON_FRAME_MAX_LEN

/* PARÁMETRO DRAIN_CHUNK_SIZE: tamaño del buffer intermedio usado para
 * sacar datos de tcp_server.c hacia 'accum'. No necesita ser grande: el
 * bucle de drenado (ver abajo) lo llama repetidamente hasta vaciar todo
 * lo pendiente. */
#define DRAIN_CHUNK_SIZE        128

static uint32_t crc_error_count;
static rx_local_action_cb_t local_action_cb;

uint32_t rx_processor_get_crc_error_count(void)
{
	return crc_error_count;
}

/* Busca y procesa todas las tramas completas ('\n'-terminadas) presentes
 * en 'buf'; conserva cualquier resto incompleto al inicio del buffer. */
static void process_complete_lines(char *buf, size_t *len)
{
	char *start = buf;
	char *end = buf + *len;

	for (;;) {
		/* COMUNICACIÓN: memchr busca el delimitador de FRAMING
		 * ('\n') dentro de lo acumulado hasta ahora; es la forma de
		 * saber "dónde termina una trama JSON completa" sobre un
		 * flujo de bytes que no tiene ese concepto por sí mismo. */
		char *newline = memchr(start, '\n', (size_t)(end - start));

		if (newline == NULL) {
			break; /* la trama actual todavia no llego completa */
		}

		size_t line_len = (size_t)(newline - start);
		struct json_command_result result;

		/* COMUNICACIÓN: única llamada a la capa de protocolo/JSON de
		 * este archivo. 'start' se pasa TAL CUAL (no const): ver la
		 * explicación de por qué en json_protocol.h/.c (decodifica
		 * in-place). Tras esta llamada, el contenido de
		 * start[0..line_len) puede estar modificado (NULs insertados
		 * donde terminaban strings JSON) — por eso no se reutiliza
		 * ese rango para nada más que result. */
		json_protocol_decode_command(start, line_len, &result);

		if (!result.format_ok) {
			LOG_WRN("Trama descartada: no se pudo decodificar como "
				"{cmd, value, crc} valido");
		} else if (!result.crc_ok) {
			crc_error_count++;
			LOG_WRN("=== ERROR DE CRC EN TRAMA RECIBIDA DESDE LA PC ===");
			LOG_WRN("  CRC recibido  : 0x%04X", result.crc_received);
			LOG_WRN("  CRC calculado : 0x%04X", result.crc_computed);
			LOG_WRN("  Trama (%d bytes) descartada por integridad", (int)line_len);
			LOG_WRN("  Contador total de errores de CRC: %u", crc_error_count);
		} else {
			LOG_INF("Trama valida recibida (value=%d)", result.value);
			if (local_action_cb != NULL) {
				/* COMUNICACIÓN: invoca el callback registrado
				 * por main.c (apply_local_action) desde ESTE
				 * hilo (rx_processor), nunca desde el hilo
				 * notificador de tcp_server.c. */
				local_action_cb(result.value, result.has_value);
			}
		}

		start = newline + 1;
	}

	/* Conserva el resto incompleto (si lo hay) al inicio del buffer,
	 * para completarlo con la próxima ronda de drenado. */
	size_t remaining = (size_t)(end - start);

	memmove(buf, start, remaining);
	*len = remaining;
}

static void rx_processor_thread_fn(void *p1, void *p2, void *p3)
{
	ARG_UNUSED(p1);
	ARG_UNUSED(p2);
	ARG_UNUSED(p3);

	static char accum[ACCUM_BUF_SIZE];
	size_t accum_len = 0;
	char chunk[DRAIN_CHUNK_SIZE];

	for (;;) {
		/* PARÁMETRO K_FOREVER: bloquea indefinidamente (0% de CPU
		 * mientras no hay datos) hasta que tcp_server.c (el
		 * "notificador", equivalente de aplicación a una ISR)
		 * libere el semaforo. Este es EXACTAMENTE el patrón
		 * "interrupción -> semáforo -> tarea bloqueada" pedido en
		 * el enunciado. */
		k_sem_take(&tcp_server_rx_ready, K_FOREVER);

		size_t n;

		/* Bucle de drenado: una sola señal del semáforo puede
		 * representar más de una ráfaga de datos ya acumulada en
		 * tcp_server.c, así que se sigue llamando a
		 * tcp_server_drain_rx() hasta que devuelva 0 (buffer vacío). */
		while ((n = tcp_server_drain_rx(chunk, sizeof(chunk))) > 0) {
			if (accum_len + n >= sizeof(accum)) {
				LOG_WRN("Buffer de reensamblado lleno: se descarta "
					"el contenido acumulado (trama demasiado larga?)");
				accum_len = 0;
				continue;
			}

			memcpy(accum + accum_len, chunk, n);
			accum_len += n;

			process_complete_lines(accum, &accum_len);
		}
	}
}

/* Ver la explicación detallada de los parámetros de K_THREAD_DEFINE en
 * tcp_server.c; aquí aplica el mismo razonamiento: se crea SUSPENDIDA
 * (K_FOREVER) y rx_processor_start() la arranca explícitamente desde
 * main(), después de que la Wi-Fi ya tiene IP. */
K_THREAD_DEFINE(rx_processor_tid, RX_PROCESSOR_STACK_SIZE, rx_processor_thread_fn,
		 NULL, NULL, NULL, RX_PROCESSOR_PRIORITY, 0, K_FOREVER);

void rx_processor_start(rx_local_action_cb_t on_command)
{
	local_action_cb = on_command;
	k_thread_start(rx_processor_tid);
}
```

## src/rx_processor.h
```c
#ifndef RX_PROCESSOR_H_
#define RX_PROCESSOR_H_

#include <stdint.h>
#include <stdbool.h>

/**
 * @brief Callback invocado por la tarea de procesamiento cada vez que
 *        llega una trama con CRC válido y un campo "value" numérico.
 *
 * Se ejecuta en el contexto de la tarea de procesamiento (no en el hilo
 * notificador de tcp_server.c), así que puede tardar unos milisegundos
 * (p. ej. parpadear un LED) sin afectar la recepción de red.
 */
typedef void (*rx_local_action_cb_t)(int value, bool has_value);

/**
 * @brief Arranca la tarea de procesamiento (creada suspendida con
 *        K_THREAD_DEFINE) y registra el callback de acción local.
 *
 * Esta tarea es la "tarea de procesamiento específica" del enunciado:
 * pasa casi todo su tiempo bloqueada en k_sem_take(&tcp_server_rx_ready,
 * K_FOREVER) (0% de CPU mientras espera) y, al despertar, drena el
 * buffer de tcp_server.c, reensambla tramas completas por línea y para
 * cada una decodifica y valida su CRC-16 (vía json_protocol.c).
 */
void rx_processor_start(rx_local_action_cb_t on_command);

/**
 * @return Número total de tramas recibidas desde la PC cuyo CRC no
 *         coincidió con el calculado localmente.
 */
uint32_t rx_processor_get_crc_error_count(void);

#endif /* RX_PROCESSOR_H_ */
```

## src/tcp_server.h
```c
#ifndef TCP_SERVER_H_
#define TCP_SERVER_H_

#include <stddef.h>
#include <stdbool.h>
#include <zephyr/kernel.h>

/**
 * Semáforo binario que cumple el rol de "interrupción" pedido en el
 * enunciado: se libera (k_sem_give) cada vez que el hilo notificador de
 * este módulo detecta y retira datos nuevos del socket TCP. La tarea de
 * procesamiento (rx_processor.c) se bloquea en k_sem_take() a la espera
 * de esta señal — nunca hace polling activo.
 *
 * Se declara con K_SEM_DEFINE a nivel de archivo en tcp_server.c, por lo
 * que ya está inicializado antes de que cualquier tarea arranque (no hay
 * condición de carrera posible con su uso vía extern aquí).
 */
extern struct k_sem tcp_server_rx_ready;

/**
 * @brief Arranca el hilo servidor TCP (creado suspendido con
 *        K_THREAD_DEFINE). Debe llamarse DESPUÉS de que la Wi-Fi tenga IP.
 *
 * Este hilo hace de "ISR de aplicación": escucha, acepta un cliente y, en
 * cuanto zsock_poll() indica datos disponibles, hace el trabajo MÍNIMO
 * (leerlos del socket y copiarlos a un buffer interno) antes de liberar
 * tcp_server_rx_ready. NO decodifica JSON ni valida CRC — eso es
 * responsabilidad exclusiva de la tarea de procesamiento.
 */
void tcp_server_start(void);

/**
 * @brief Envía una trama ya construida (incluyendo el '\n' final) al
 *        cliente actualmente conectado, si lo hay. Usada por la tarea
 *        periódica de telemetría (telemetry_tx.c).
 *
 * @return true si había un cliente conectado y se intentó el envío;
 *         false si no hay ningún cliente conectado en este momento.
 */
bool tcp_server_send(const char *frame, size_t len);

/**
 * @brief Retira hasta dst_max bytes ya recibidos (y aún no consumidos)
 *        del buffer interno, en orden FIFO.
 *
 * Pensada para ser llamada EN BUCLE por la tarea de procesamiento
 * (rx_processor.c) tras despertar de tcp_server_rx_ready, hasta que
 * devuelva 0 (buffer vaciado). Es la única forma en que otro módulo toca
 * los datos crudos del socket: el acceso concurrente con el hilo
 * notificador está protegido internamente por un mutex, y la sección
 * crítica se mantiene deliberadamente corta.
 *
 * @return Número de bytes copiados a dst (puede ser 0).
 */
size_t tcp_server_drain_rx(char *dst, size_t dst_max);

#endif /* TCP_SERVER_H_ */
```

## src/telemetry_tx.c
```c
/*
 * telemetry_tx.c
 * ================
 * POR QUÉ este módulo existe: es la "Tarea de Envío (Simulación)" del
 * enunciado. Corre de forma completamente independiente del notificador
 * TCP (tcp_server.c) y de la tarea de procesamiento (rx_processor.c): las
 * tres son tareas Zephyr separadas que el scheduler intercala.
 *
 * CON QUÉ se comunica: con json_protocol.c (para construir la trama) y
 * con tcp_server.c (para enviarla por el socket del cliente conectado).
 */

#include <zephyr/kernel.h>
#include <zephyr/logging/log.h>

#include "telemetry_tx.h"
#include "tcp_server.h"
#include "rx_processor.h"
#include "json_protocol.h"
#include "network_config.h"

LOG_MODULE_REGISTER(telemetry_tx, LOG_LEVEL_INF);

/* PARÁMETROS de hilo: mismo criterio de tamaño/prioridad documentado en
 * tcp_server.c (4 KiB cubre los buffers locales de json_protocol.c;
 * prioridad 5 = misma prioridad que las otras dos tareas, el scheduler
 * las alterna por turnos). */
#define TX_STACK_SIZE 4096
#define TX_PRIORITY   5

static void telemetry_tx_thread_fn(void *p1, void *p2, void *p3)
{
	ARG_UNUSED(p1);
	ARG_UNUSED(p2);
	ARG_UNUSED(p3);

	/* 'seq' vive en la pila del hilo (no es global) porque solo esta
	 * tarea la usa; se declara aquí, fuera del bucle, para que persista
	 * entre iteraciones en vez de reiniciarse en 0 cada vez. */
	uint32_t seq = 0;

	for (;;) {
		char frame[JSON_FRAME_MAX_LEN];

		/* POR QUÉ "value" cambia cada ciclo: es el requisito
		 * explícito del enunciado ("cambiando los datos en cada
		 * ciclo para alterar dinámicamente el CRC"). Aquí se usa un
		 * patrón simple y determinista (0..99, con "%") en vez de un
		 * sensor real, para que el proyecto funcione sin hardware
		 * adicional; en un proyecto real, esta línea es el ÚNICO
		 * lugar que habría que tocar para leer un sensor de verdad
		 * (el resto del pipeline -- esquema, CRC, envío -- no
		 * cambia). Se mantiene como "int" (no float) para no
		 * depender de soporte de punto flotante en el enlazador. */
		int simulated_value = (int)(seq % 100);

		/* COMUNICACIÓN: construye la trama completa (payload + CRC
		 * + '\n') delegando TODO el trabajo de JSON/CRC a
		 * json_protocol.c. PARÁMETROS:
		 *   - seq: contador de esta tarea, para que la PC pueda
		 *     notar tramas perdidas/reordenadas.
		 *   - k_uptime_get(): milisegundos desde el arranque de la
		 *     ESP32 -- referencia temporal sin necesitar RTC externo;
		 *     se castea a uint32_t porque el esquema define
		 *     "uptime_ms" como entero de 32 bits (suficiente para
		 *     ~49 dias de uptime, más que de sobra para este proyecto).
		 *   - rx_processor_get_crc_error_count(): así la telemetría
		 *     también informa a la PC cuántos errores de CRC detectó
		 *     la ESP32 del lado de los comandos entrantes. */
		int frame_len = json_protocol_build_telemetry(
			frame, sizeof(frame), seq, (uint32_t)k_uptime_get(),
			simulated_value, rx_processor_get_crc_error_count());

		if (frame_len > 0) {
			/* COMUNICACIÓN: tcp_server_send() usa internamente el
			 * socket del cliente actualmente conectado (si lo
			 * hay); si no hay cliente, devuelve false y esta
			 * tarea simplemente sigue con el próximo ciclo -- no
			 * es un error, es el estado normal antes de que la
			 * PC se conecte. */
			if (!tcp_server_send(frame, (size_t)frame_len)) {
				LOG_DBG("Sin cliente conectado: telemetria no enviada");
			}
		} else {
			LOG_WRN("No se pudo construir la trama de telemetria (buffer insuficiente?)");
		}

		seq++;

		/* PARÁMETRO TELEMETRY_PERIOD_MS (network_config.h, por
		 * defecto 2000 ms): k_msleep() cede la CPU durante ese
		 * tiempo -- esta tarea NO consume ciclos de procesador
		 * mientras "duerme", dejando esos ciclos disponibles para
		 * tcp_server.c/rx_processor.c. */
		k_msleep(TELEMETRY_PERIOD_MS);
	}
}

/* Ver la explicación detallada de los parámetros de K_THREAD_DEFINE en
 * tcp_server.c. Igual que las otras dos tareas, se crea SUSPENDIDA
 * (K_FOREVER) para no intentar enviar nada antes de que la Wi-Fi tenga IP
 * y el servidor TCP ya exista. */
K_THREAD_DEFINE(telemetry_tx_tid, TX_STACK_SIZE, telemetry_tx_thread_fn,
		 NULL, NULL, NULL, TX_PRIORITY, 0, K_FOREVER);

void telemetry_tx_start(void)
{
	k_thread_start(telemetry_tx_tid);
}
```
