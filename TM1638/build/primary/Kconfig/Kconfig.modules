## TM1638/build/primary/Kconfig/Kconfig.modules
```kconfig
menu "cmsis_6 (C:/Users/razie/OneDrive/Documentos/PowerShell/STM32/deps/modules/hal/cmsis_6)"
osource "$(ZEPHYR_CMSIS_6_KCONFIG)"
config ZEPHYR_CMSIS_6_MODULE
	bool
	default y
endmenu
config ZEPHYR_HAL_STM32_MODULE
	bool
	default y
	select TAINT_BLOBS

config ZEPHYR_HAL_STM32_MODULE_BLOBS
	bool
	default y
menu "mbedtls (C:/Users/razie/OneDrive/Documentos/PowerShell/STM32/deps/modules/crypto/mbedtls)"
osource "$(ZEPHYR_MBEDTLS_KCONFIG)"
config ZEPHYR_MBEDTLS_MODULE
	bool
	default y
endmenu
config ZEPHYR_MCUBOOT_MODULE
	bool
	default y
menu "percepio (C:/Users/razie/OneDrive/Documentos/PowerShell/STM32/deps/modules/debug/percepio)"
osource "C:/Users/razie/OneDrive/Documentos/PowerShell/STM32/deps/modules/debug/percepio/zephyr/Kconfig"
config ZEPHYR_PERCEPIO_MODULE
	bool
	default y
endmenu
menu "picolibc (C:/Users/razie/OneDrive/Documentos/PowerShell/STM32/deps/modules/lib/picolibc)"
osource "C:/Users/razie/OneDrive/Documentos/PowerShell/STM32/deps/modules/lib/picolibc/zephyr/Kconfig"
config ZEPHYR_PICOLIBC_MODULE
	bool
	default y
endmenu
menu "segger (C:/Users/razie/OneDrive/Documentos/PowerShell/STM32/deps/modules/debug/segger)"
osource "$(ZEPHYR_SEGGER_KCONFIG)"
config ZEPHYR_SEGGER_MODULE
	bool
	default y
endmenu
config ZEPHYR_TF_PSA_CRYPTO_MODULE
	bool
	default y
menu "trusted-firmware-m (C:/Users/razie/OneDrive/Documentos/PowerShell/STM32/deps/modules/tee/tf-m/trusted-firmware-m)"
osource "$(ZEPHYR_TRUSTED_FIRMWARE_M_KCONFIG)"
config ZEPHYR_TRUSTED_FIRMWARE_M_MODULE
	bool
	default y
endmenu
```

## TM1638/build/primary/Kconfig/Kconfig.sysbuild.modules
```kconfig
config ZEPHYR_CMSIS_6_MODULE
   bool
   default y
config ZEPHYR_HAL_STM32_MODULE
   bool
   default y
config ZEPHYR_MBEDTLS_MODULE
   bool
   default y
config ZEPHYR_MCUBOOT_MODULE
   bool
   default y
config ZEPHYR_PERCEPIO_MODULE
   bool
   default y
config ZEPHYR_PICOLIBC_MODULE
   bool
   default y
config ZEPHYR_SEGGER_MODULE
   bool
   default y
config ZEPHYR_TF_PSA_CRYPTO_MODULE
   bool
   default y
config ZEPHYR_TRUSTED_FIRMWARE_M_MODULE
   bool
   default y
```

## TM1638/build/primary/Kconfig/arch/Kconfig.tmp
```kconfig
# Load Zephyr Arch Kconfig descriptions.
osource "C:/Users/razie/OneDrive/Documentos/PowerShell/STM32/deps/zephyr/arch/rx/Kconfig"
osource "C:/Users/razie/OneDrive/Documentos/PowerShell/STM32/deps/zephyr/arch/x86/Kconfig"
osource "C:/Users/razie/OneDrive/Documentos/PowerShell/STM32/deps/zephyr/arch/xtensa/Kconfig"
osource "C:/Users/razie/OneDrive/Documentos/PowerShell/STM32/deps/zephyr/arch/sparc/Kconfig"
osource "C:/Users/razie/OneDrive/Documentos/PowerShell/STM32/deps/zephyr/arch/riscv/Kconfig"
osource "C:/Users/razie/OneDrive/Documentos/PowerShell/STM32/deps/zephyr/arch/posix/Kconfig"
osource "C:/Users/razie/OneDrive/Documentos/PowerShell/STM32/deps/zephyr/arch/openrisc/Kconfig"
osource "C:/Users/razie/OneDrive/Documentos/PowerShell/STM32/deps/zephyr/arch/mips/Kconfig"
osource "C:/Users/razie/OneDrive/Documentos/PowerShell/STM32/deps/zephyr/arch/arm64/Kconfig"
osource "C:/Users/razie/OneDrive/Documentos/PowerShell/STM32/deps/zephyr/arch/arm/Kconfig"
osource "C:/Users/razie/OneDrive/Documentos/PowerShell/STM32/deps/zephyr/arch/arc/Kconfig"
```

## TM1638/build/primary/Kconfig/boards/Kconfig.defconfig.tmp
```kconfig
# Load Zephyr board defconfig descriptions.
osource "C:/Users/razie/OneDrive/Documentos/PowerShell/STM32/deps/zephyr/boards/st/nucleo_f401re/Kconfig.defconfig"
```

## TM1638/build/primary/Kconfig/boards/Kconfig.nucleo_f401re.tmp
```kconfig
# Load board Kconfig descriptions.
osource "C:/Users/razie/OneDrive/Documentos/PowerShell/STM32/deps/zephyr/boards/st/nucleo_f401re/Kconfig.nucleo_f401re"
```

## TM1638/build/primary/Kconfig/boards/Kconfig.tmp
```kconfig
# Load Zephyr board Kconfig descriptions.
osource "C:/Users/razie/OneDrive/Documentos/PowerShell/STM32/deps/zephyr/boards/st/nucleo_f401re/Kconfig"
```

## files/wifi/Kconfig
```kconfig
# Kconfig
# Opciones de configuración propias de la aplicación. Se fijan con valores
# por defecto aquí y se sobrescriben en prj.conf (o con `west build -t menuconfig`).

menu "Configuración del puente TCP/JSON (ESP32)"

config APP_WIFI_SSID
	string "SSID de la red Wi-Fi local"
	default "MI_RED_WIFI"
	help
	  Nombre (SSID) de la red Wi-Fi 2.4 GHz a la que se conectará la ESP32.

config APP_WIFI_PSK
	string "Contraseña (PSK) de la red Wi-Fi"
	default "MI_CONTRASENA"
	help
	  Contraseña de la red Wi-Fi (WPA2-PSK). Evita dejar credenciales reales
	  versionadas en un repositorio; en un proyecto productivo, inyéctalas
	  por variable de entorno de compilación o por un prj.conf local
	  ignorado por git.

config APP_TCP_PORT
	int "Puerto TCP en el que escucha la ESP32"
	default 5000
	range 1 65535
	help
	  La ESP32 actúa como servidor TCP: escucha en este puerto a la espera
	  de que la aplicación de PC se conecte como cliente.

config APP_TELEMETRY_PERIOD_MS
	int "Período de envío de telemetría (ms)"
	default 2000
	help
	  Cada cuánto tiempo la ESP32 arma y envía una trama JSON de telemetría
	  al cliente TCP conectado (si hay alguno).

endmenu

source "Kconfig.zephyr"
```

## zephyrproject/applications/blinky/build/primary/Kconfig/Kconfig.modules
```kconfig
menu "cmsis_6 (C:/zephyr/zephyrproject/deps/modules/hal/cmsis_6)"
osource "$(ZEPHYR_CMSIS_6_KCONFIG)"
config ZEPHYR_CMSIS_6_MODULE
	bool
	default y
endmenu
config ZEPHYR_HAL_STM32_MODULE
	bool
	default y
	select TAINT_BLOBS

config ZEPHYR_HAL_STM32_MODULE_BLOBS
	bool
	default y
menu "mbedtls (C:/zephyr/zephyrproject/deps/modules/crypto/mbedtls)"
osource "$(ZEPHYR_MBEDTLS_KCONFIG)"
config ZEPHYR_MBEDTLS_MODULE
	bool
	default y
endmenu
config ZEPHYR_MCUBOOT_MODULE
	bool
	default y
menu "percepio (C:/zephyr/zephyrproject/deps/modules/debug/percepio)"
osource "C:/zephyr/zephyrproject/deps/modules/debug/percepio/zephyr/Kconfig"
config ZEPHYR_PERCEPIO_MODULE
	bool
	default y
endmenu
menu "picolibc (C:/zephyr/zephyrproject/deps/modules/lib/picolibc)"
osource "C:/zephyr/zephyrproject/deps/modules/lib/picolibc/zephyr/Kconfig"
config ZEPHYR_PICOLIBC_MODULE
	bool
	default y
endmenu
menu "segger (C:/zephyr/zephyrproject/deps/modules/debug/segger)"
osource "$(ZEPHYR_SEGGER_KCONFIG)"
config ZEPHYR_SEGGER_MODULE
	bool
	default y
endmenu
config ZEPHYR_TF_PSA_CRYPTO_MODULE
	bool
	default y
menu "trusted-firmware-m (C:/zephyr/zephyrproject/deps/modules/tee/tf-m/trusted-firmware-m)"
osource "$(ZEPHYR_TRUSTED_FIRMWARE_M_KCONFIG)"
config ZEPHYR_TRUSTED_FIRMWARE_M_MODULE
	bool
	default y
endmenu
```

## zephyrproject/applications/blinky/build/primary/Kconfig/arch/Kconfig
```kconfig
# Load Zephyr Arch Kconfig descriptions.
osource "C:/zephyr/zephyrproject/deps/zephyr/arch/rx/Kconfig"
osource "C:/zephyr/zephyrproject/deps/zephyr/arch/x86/Kconfig"
osource "C:/zephyr/zephyrproject/deps/zephyr/arch/xtensa/Kconfig"
osource "C:/zephyr/zephyrproject/deps/zephyr/arch/sparc/Kconfig"
osource "C:/zephyr/zephyrproject/deps/zephyr/arch/riscv/Kconfig"
osource "C:/zephyr/zephyrproject/deps/zephyr/arch/posix/Kconfig"
osource "C:/zephyr/zephyrproject/deps/zephyr/arch/openrisc/Kconfig"
osource "C:/zephyr/zephyrproject/deps/zephyr/arch/mips/Kconfig"
osource "C:/zephyr/zephyrproject/deps/zephyr/arch/arm64/Kconfig"
osource "C:/zephyr/zephyrproject/deps/zephyr/arch/arm/Kconfig"
osource "C:/zephyr/zephyrproject/deps/zephyr/arch/arc/Kconfig"
```

## zephyrproject/applications/blinky/build/primary/Kconfig/boards/Kconfig.defconfig.tmp
```kconfig
# Load Zephyr board defconfig descriptions.
osource "C:/zephyr/zephyrproject/deps/zephyr/boards/st/nucleo_f401re/Kconfig.defconfig"
```

## zephyrproject/applications/blinky/build/primary/Kconfig/boards/Kconfig.nucleo_f401re.tmp
```kconfig
# Load board Kconfig descriptions.
osource "C:/zephyr/zephyrproject/deps/zephyr/boards/st/nucleo_f401re/Kconfig.nucleo_f401re"
```

## zephyrproject/applications/blinky/build/primary/Kconfig/boards/Kconfig.sysbuild.tmp
```kconfig
# Load Sysbuild board Kconfig descriptions.
osource "C:/zephyr/zephyrproject/deps/zephyr/boards/st/nucleo_f401re/Kconfig.sysbuild"
```
