## CMakeLists.txt
```
# CMakeLists.txt
# Proyecto Zephyr RTOS: puente TCP/JSON con verificación CRC-16 para ESP32.
# Arquitectura de 3 tareas: notificador TCP (rol de ISR), procesador RX
# (bloqueado en un semáforo binario) y emisor periódico de telemetría.

cmake_minimum_required(VERSION 3.20.0)

find_package(Zephyr REQUIRED HINTS $ENV{ZEPHYR_BASE})
project(esp32_tcp_json_bridge)

target_sources(app PRIVATE
    src/main.c
    src/wifi_manager.c
    src/tcp_server.c
    src/rx_processor.c
    src/telemetry_tx.c
)

target_include_directories(app PRIVATE src)
```

## Kconfig
```
# Kconfig
# Opciones de configuración propias de la aplicación. Se fijan con valores
# por defecto aquí y se sobrescriben en prj.conf (o con `west build -t menuconfig`).

menu "Configuración del puente TCP/JSON (ESP32)"

config APP_WIFI_SSID
	string "SSID de la red Wi-Fi local"
	default "MI_RED_WIFI"
	help
	  Nombre (SSID) de la red Wi-Fi 2.4 GHz a la que se conectará la ESP32.
	  También puede modificarse en caliente antes de compilar editando
	  prj.conf, sin tocar el código C.

config APP_WIFI_PSK
	string "Contraseña (PSK) de la red Wi-Fi"
	default "MI_CONTRASENA"
	help
	  Contraseña de la red Wi-Fi (WPA2-PSK). Evita dejar credenciales
	  reales versionadas en un repositorio.

config APP_TCP_PORT
	int "Puerto TCP en el que escucha la ESP32"
	default 5000
	range 1 65535
	help
	  La ESP32 actúa como servidor TCP: escucha en este puerto a la espera
	  de que la aplicación de PC se conecte como cliente.

config APP_TELEMETRY_PERIOD_MS
	int "Período de la tarea de envío de telemetría (ms)"
	default 2000
	help
	  Cada cuánto tiempo la tarea periódica arma y envía una trama JSON de
	  telemetría (con datos simulados que cambian en cada ciclo) al
	  cliente TCP conectado, si lo hay.

endmenu

source "Kconfig.zephyr"
```

## prj.conf
```kconfig
# prj.conf
# Configuración de Zephyr para el puente TCP/JSON entre la ESP32 y la PC.
#
# NOTA IMPORTANTE: los nombres exactos de algunas opciones del driver Wi-Fi
# de la ESP32 (p. ej. CONFIG_WIFI_ESP32) pueden variar levemente según la
# versión de Zephyr y del módulo HAL de Espressif que tengas instalado.
# Si `west build` reporta que una opción "no existe", ejecuta
# `west build -t menuconfig`, busca "ESP32" / "WIFI" y ajusta el nombre.

# --- Kernel / logging ---
CONFIG_MAIN_STACK_SIZE=4096
CONFIG_LOG=y
CONFIG_LOG_DEFAULT_LEVEL=3
CONFIG_PRINTK=y

# --- GPIO (LED de acción local) ---
CONFIG_GPIO=y

# --- Red: base TCP/IP ---
CONFIG_NETWORKING=y
CONFIG_NET_IPV4=y
CONFIG_NET_IPV6=n
CONFIG_NET_TCP=y
CONFIG_NET_SOCKETS=y
CONFIG_NET_DHCPV4=y

# Buffers de red: las tramas de este proyecto son pequeñas (< 256 B), pero
# se deja margen para varios paquetes en vuelo.
CONFIG_NET_PKT_RX_COUNT=16
CONFIG_NET_PKT_TX_COUNT=16
CONFIG_NET_BUF_RX_COUNT=32
CONFIG_NET_BUF_TX_COUNT=32
CONFIG_NET_MAX_CONTEXTS=6

# --- Wi-Fi ---
CONFIG_WIFI=y
CONFIG_WIFI_ESP32=y
CONFIG_NET_L2_WIFI_MGMT=y
CONFIG_NET_MGMT=y
CONFIG_NET_MGMT_EVENT=y
CONFIG_NET_MGMT_EVENT_INFO=y

# Heap adicional que usan el driver Wi-Fi y la pila de red
CONFIG_HEAP_MEM_POOL_SIZE=65536

# --- Valores de la aplicación (ver Kconfig del proyecto) ---
# SSID y contraseña de la red: la forma recomendada de modificarlos es
# EDITAR ESTAS DOS LÍNEAS antes de compilar (no hace falta tocar main.c).
CONFIG_APP_WIFI_SSID="MigAn"
CONFIG_APP_WIFI_PSK="Raziel-2707"
CONFIG_APP_TCP_PORT=5000
CONFIG_APP_TELEMETRY_PERIOD_MS=2000
```

## src/crc16.c
```c
#include "crc16.h"

uint16_t crc16_ccitt_false(const uint8_t *data, size_t len)
{
	uint16_t crc = 0xFFFF;

	for (size_t i = 0; i < len; i++) {
		crc ^= (uint16_t)data[i] << 8;

		for (int bit = 0; bit < 8; bit++) {
			if (crc & 0x8000) {
				crc = (uint16_t)((crc << 1) ^ 0x1021);
			} else {
				crc = (uint16_t)(crc << 1);
			}
		}
	}

	return crc;
}
```

## src/crc16.h
```c
#ifndef CRC16_H_
#define CRC16_H_

#include <stddef.h>
#include <stdint.h>

/**
 * @brief Calcula el CRC-16/CCITT-FALSE de un bloque de datos.
 *
 * Implementación manual, bit a bit (no depende de zephyr/sys/crc.h), para
 * poder documentar y replicar EXACTAMENTE el mismo algoritmo en el lado
 * PC (ver protocol.py). Parámetros del algoritmo:
 *
 *   - Polinomio:       0x1021
 *   - Valor inicial:   0xFFFF
 *   - Reflejado (in):  No
 *   - Reflejado (out): No
 *   - XOR de salida:   0x0000
 *
 * Vector de prueba estándar para validar cualquier reimplementación:
 *   crc16_ccitt_false((uint8_t *)"123456789", 9) == 0x29B1
 *
 * @param data Puntero al buffer de datos.
 * @param len  Longitud en bytes del buffer.
 * @return Valor de 16 bits del CRC calculado.
 */
uint16_t crc16_ccitt_false(const uint8_t *data, size_t len);

#endif /* CRC16_H_ */
```

## src/json_config.h
```c
#ifndef JSON_CONFIG_H_
#define JSON_CONFIG_H_

#include <zephyr/data/json.h>
#include <stdint.h>
#include <stdbool.h>

#define JSON_FRAME_MAX_LEN 256

/* =========================================================================
 * ZONA ALTAMENTE MODIFICABLE: REUTILIZA ESTE ARCHIVO EN CUALQUIER PROYECTO
 * =========================================================================
 * Para añadir un nuevo sensor o variable, sigue 3 pasos:
 * 1. Añade tu variable `int nueva_var;` a la estructura (tx o rx).
 * 2. Añádela al arreglo de descriptores correspondiente.
 * 3. Añádela a la función de cálculo de CRC con un XOR (^).
 */

/* --- 1. ESTRUCTURAS DE DATOS --- */

// Datos que el ESP32 ENVÍA al PC
struct datos_tx {
	int id_dispositivo;
	int temperatura;
	int humedad;
	int crc; // IMPORTANTE: El CRC siempre debe ir
};

// Datos que el ESP32 RECIBE del PC
struct datos_rx {
	int comando_led;
	int setpoint_temp;
	int crc; // IMPORTANTE: El CRC siempre debe ir
};

/* --- 2. DESCRIPTORES JSON (Mapeo de Variables C <-> JSON Keys) --- */

static const struct json_obj_descr tx_descr[] = {
	JSON_OBJ_DESCR_PRIM(struct datos_tx, id_dispositivo, JSON_TOK_NUMBER),
	JSON_OBJ_DESCR_PRIM(struct datos_tx, temperatura, JSON_TOK_NUMBER),
	JSON_OBJ_DESCR_PRIM(struct datos_tx, humedad, JSON_TOK_NUMBER),
	JSON_OBJ_DESCR_PRIM(struct datos_tx, crc, JSON_TOK_NUMBER),
};
static const size_t tx_descr_len = ARRAY_SIZE(tx_descr);

static const struct json_obj_descr rx_descr[] = {
	JSON_OBJ_DESCR_PRIM(struct datos_rx, comando_led, JSON_TOK_NUMBER),
	JSON_OBJ_DESCR_PRIM(struct datos_rx, setpoint_temp, JSON_TOK_NUMBER),
	JSON_OBJ_DESCR_PRIM(struct datos_rx, crc, JSON_TOK_NUMBER),
};
static const size_t rx_descr_len = ARRAY_SIZE(rx_descr);

/* --- 3. CÁLCULO DE CRC (Algoritmo XOR acumulativo) --- */

// 1. Comando: calculate_crc_tx
// El porqué: Genera una firma matemática basada exclusivamente en las variables útiles, permitiendo que la codificación JSON y el orden de los campos no rompan la validación.
// La comunicación: Sirve para confirmar integridad hacia Python.
// Los parámetros: Un puntero a la estructura `datos_tx` que contiene los valores a validar.
static inline int calculate_crc_tx(struct datos_tx *d) {
    // Aplica XOR a todas tus variables para la firma
    return (d->id_dispositivo ^ d->temperatura ^ d->humedad) & 0xFFFF;
}

static inline int calculate_crc_rx(struct datos_rx *d) {
    // Aplica XOR a todas las variables recibidas
    return (d->comando_led ^ d->setpoint_temp) & 0xFFFF;
}

#endif /* JSON_CONFIG_H_ */
```

## src/json_protocol.c
```c
#include "json_protocol.h"

const struct json_obj_descr tx_telemetry_descr[] = {
	JSON_OBJ_DESCR_PRIM(struct tx_telemetry, seq, JSON_TOK_NUMBER),
	JSON_OBJ_DESCR_PRIM(struct tx_telemetry, uptime_ms, JSON_TOK_NUMBER),
	JSON_OBJ_DESCR_PRIM(struct tx_telemetry, value, JSON_TOK_NUMBER),
	JSON_OBJ_DESCR_PRIM(struct tx_telemetry, esp32_crc_errors, JSON_TOK_NUMBER),
	JSON_OBJ_DESCR_PRIM(struct tx_telemetry, crc, JSON_TOK_NUMBER),
};
const size_t tx_telemetry_descr_len = ARRAY_SIZE(tx_telemetry_descr);

const struct json_obj_descr rx_command_descr[] = {
	JSON_OBJ_DESCR_PRIM(struct rx_command, cmd_val, JSON_TOK_NUMBER),
	JSON_OBJ_DESCR_PRIM(struct rx_command, crc, JSON_TOK_NUMBER),
};
const size_t rx_command_descr_len = ARRAY_SIZE(rx_command_descr);
```

## src/json_protocol.h
```c
#ifndef JSON_PROTOCOL_H_
#define JSON_PROTOCOL_H_

#include <zephyr/data/json.h>
#include <stdint.h>
#include <stdbool.h>

#define JSON_FRAME_MAX_LEN 256

/* Estructura para TX (Telemetría) */
struct tx_telemetry {
	int seq;
	int uptime_ms;
	int value;
	int esp32_crc_errors;
	int crc;
};

extern const struct json_obj_descr tx_telemetry_descr[];
extern const size_t tx_telemetry_descr_len;

/* Estructura para RX (Comandos) */
struct rx_command {
	int cmd_val;
	int crc;
};

extern const struct json_obj_descr rx_command_descr[];
extern const size_t rx_command_descr_len;

static inline int calculate_simple_crc(int val) {
    return (val ^ 0xAAAA) & 0xFFFF;
}

#endif /* JSON_PROTOCOL_H_ */
```

## src/rx_processor.c
```c
#include <string.h>

#include <zephyr/kernel.h>
#include <zephyr/logging/log.h>

#include "rx_processor.h"
#include "tcp_server.h"
#include "json_config.h"

LOG_MODULE_REGISTER(rx_processor, LOG_LEVEL_INF);

#define RX_PROCESSOR_STACK_SIZE 4096
#define RX_PROCESSOR_PRIORITY   5
#define ACCUM_BUF_SIZE          JSON_FRAME_MAX_LEN
#define DRAIN_CHUNK_SIZE        128

static uint32_t crc_error_count;
static rx_local_action_cb_t local_action_cb;

uint32_t rx_processor_get_crc_error_count(void)
{
	return crc_error_count;
}

static void process_complete_lines(char *buf, size_t *len)
{
	char *start = buf;
	char *end = buf + *len;

	for (;;) {
		char *newline = memchr(start, '\n', (size_t)(end - start));

		if (newline == NULL) {
			break;
		}

		size_t line_len = (size_t)(newline - start);
		
		struct datos_rx result = {0};

		// 5. Comando: json_obj_parse
		// El porqué: Decodifica usando Zephyr de forma nativa hacia nuestro struct flexible.
		int ret = json_obj_parse(start, line_len, rx_descr, rx_descr_len, &result);

		if (ret < 0) {
			LOG_WRN("Trama descartada: Error de parseo JSON nativo (ret=%d)", ret);
		} else {
			// 6. Comando: calculate_crc_rx
			// El porqué: Valida integridad contra la firma de las variables útiles esperadas.
			int expected_crc = calculate_crc_rx(&result);
			if (expected_crc != result.crc) {
				crc_error_count++;
				LOG_WRN("ERROR DE CRC. Recibido: 0x%04X, Calculado: 0x%04X", result.crc, expected_crc);
			} else {
				LOG_INF("Trama valida (comando_led=%d, setpoint=%d)", result.comando_led, result.setpoint_temp);
				if (local_action_cb != NULL) {
					local_action_cb(result.comando_led, true);
				}
			}
		}

		start = newline + 1;
	}

	size_t remaining = (size_t)(end - start);
	memmove(buf, start, remaining);
	*len = remaining;
}

static void rx_processor_thread_fn(void *p1, void *p2, void *p3)
{
	ARG_UNUSED(p1);
	ARG_UNUSED(p2);
	ARG_UNUSED(p3);

	static char accum[ACCUM_BUF_SIZE];
	size_t accum_len = 0;
	char chunk[DRAIN_CHUNK_SIZE];

	for (;;) {
		// 7. Comando: k_sem_take
		// El porqué: Sincroniza Bottom-Half, logrando que el parseo JSON pesado no ocurra en la simulación de ISR de Red.
		k_sem_take(&tcp_server_rx_ready, K_FOREVER);

		size_t n;
		while ((n = tcp_server_drain_rx(chunk, sizeof(chunk))) > 0) {
			if (accum_len + n >= sizeof(accum)) {
				LOG_WRN("Buffer lleno, descartando data");
				accum_len = 0;
				continue;
			}
			memcpy(accum + accum_len, chunk, n);
			accum_len += n;
			process_complete_lines(accum, &accum_len);
		}
	}
}

K_THREAD_DEFINE(rx_processor_tid, RX_PROCESSOR_STACK_SIZE, rx_processor_thread_fn,
		 NULL, NULL, NULL, RX_PROCESSOR_PRIORITY, 0, -1);

void rx_processor_start(rx_local_action_cb_t on_command)
{
	local_action_cb = on_command;
	k_thread_start(rx_processor_tid);
}
```

## src/tcp_server.c
```c
/*
 * tcp_server.c
 *
 * Este módulo escucha conexiones TCP entrantes y, cuando llegan datos,
 * actúa como el "manejador de interrupción" pedido en el enunciado:
 *
 *   - Zephyr, igual que cualquier RTOS con pila TCP/IP, NO expone a la
 *     aplicación una IRQ de hardware para "el socket tiene datos": la
 *     interrupción real del hardware Wi-Fi la atiende internamente el
 *     driver, varias capas por debajo del API de sockets. Simular eso
 *     aquí sería falso.
 *   - Lo que SÍ se implementa, fielmente, es la disciplina que se le
 *     exige a una ISR: el hilo de este módulo hace el trabajo MÍNIMO
 *     posible (mover los bytes ya disponibles del socket a un buffer
 *     interno) y de inmediato libera un semáforo binario
 *     (tcp_server_rx_ready), delegando TODO el procesamiento pesado
 *     (parseo JSON, verificación de CRC, log detallado, acción local) a
 *     una tarea separada y bloqueada -- rx_processor.c -- tal como una
 *     ISR real delega su trabajo a un hilo en vez de hacerlo ella misma.
 */

#include <string.h>
#include <errno.h>

#include <zephyr/kernel.h>
#include <zephyr/logging/log.h>
#include <zephyr/net/socket.h>
#include <zephyr/net/net_ip.h>
#include <zephyr/sys/util.h>

#include "tcp_server.h"

LOG_MODULE_REGISTER(tcp_server, LOG_LEVEL_INF);

#define TCP_SERVER_STACK_SIZE 4096
#define TCP_SERVER_PRIORITY   5
#define POLL_TIMEOUT_MS       500
#define RECV_CHUNK_SIZE       128
#define SHARED_BUF_SIZE       256

/* K_MUTEX_DEFINE / K_SEM_DEFINE inicializan estos objetos de forma
 * ESTÁTICA (antes de que main() empiece a correr), a diferencia de
 * k_mutex_init()/k_sem_init() llamados dentro de un hilo en tiempo de
 * ejecución. Esto elimina cualquier condición de carrera entre el orden
 * de arranque de los hilos de la aplicación y el primer uso de estos
 * objetos (p. ej. rx_processor arrancando antes de que este módulo
 * termine de inicializar el semáforo). */
K_MUTEX_DEFINE(client_mutex);
K_MUTEX_DEFINE(shared_buf_mutex);
K_SEM_DEFINE(tcp_server_rx_ready, 0, 1);

static int client_fd = -1;
static char shared_buf[SHARED_BUF_SIZE];
static size_t shared_buf_len;

static void set_client_fd(int fd)
{
	k_mutex_lock(&client_mutex, K_FOREVER);
	client_fd = fd;
	k_mutex_unlock(&client_mutex);
}

static int get_client_fd(void)
{
	k_mutex_lock(&client_mutex, K_FOREVER);
	int fd = client_fd;
	k_mutex_unlock(&client_mutex);
	return fd;
}

bool tcp_server_send(const char *frame, size_t len)
{
	int fd = get_client_fd();

	if (fd < 0) {
		return false;
	}

	if (zsock_send(fd, frame, len, 0) < 0) {
		LOG_WRN("Error enviando datos al cliente (errno=%d)", errno);
	}

	return true;
}

size_t tcp_server_drain_rx(char *dst, size_t dst_max)
{
	k_mutex_lock(&shared_buf_mutex, K_FOREVER);

	size_t n = MIN(dst_max, shared_buf_len);

	if (n > 0) {
		memcpy(dst, shared_buf, n);
		memmove(shared_buf, shared_buf + n, shared_buf_len - n);
		shared_buf_len -= n;
	}

	k_mutex_unlock(&shared_buf_mutex);

	return n;
}

/* Equivalente, a nivel de aplicación, del "cuerpo de la ISR": trabajo
 * mínimo (copiar bytes a un buffer compartido) y señalización inmediata.
 * NO parsea JSON, NO valida CRC, NO imprime detalles del contenido. */
static void notify_data_available(const char *data, size_t len)
{
	k_mutex_lock(&shared_buf_mutex, K_FOREVER);

	size_t space = sizeof(shared_buf) - shared_buf_len;
	size_t to_copy = MIN(len, space);

	if (to_copy < len) {
		LOG_WRN("Buffer compartido de RX lleno: se descartan %d bytes "
			"(la tarea de procesamiento no está drenando a tiempo)",
			(int)(len - to_copy));
	}

	memcpy(shared_buf + shared_buf_len, data, to_copy);
	shared_buf_len += to_copy;

	k_mutex_unlock(&shared_buf_mutex);

	/* "Interrupción" de aplicación: despierta a rx_processor_thread_fn,
	 * que está bloqueada en k_sem_take(&tcp_server_rx_ready, K_FOREVER). */
	k_sem_give(&tcp_server_rx_ready);
}

static void tcp_server_thread(void *p1, void *p2, void *p3)
{
	ARG_UNUSED(p1);
	ARG_UNUSED(p2);
	ARG_UNUSED(p3);

	int listen_fd = zsock_socket(AF_INET, SOCK_STREAM, IPPROTO_TCP);

	if (listen_fd < 0) {
		LOG_ERR("No se pudo crear el socket de escucha (errno=%d)", errno);
		return;
	}

	int reuse = 1;

	zsock_setsockopt(listen_fd, SOL_SOCKET, SO_REUSEADDR, &reuse, sizeof(reuse));

	struct sockaddr_in bind_addr = {
		.sin_family = AF_INET,
		.sin_port = htons(CONFIG_APP_TCP_PORT),
		.sin_addr.s_addr = htonl(INADDR_ANY),
	};

	if (zsock_bind(listen_fd, (struct sockaddr *)&bind_addr, sizeof(bind_addr)) < 0) {
		LOG_ERR("No se pudo asociar (bind) el puerto %d (errno=%d)",
			CONFIG_APP_TCP_PORT, errno);
		zsock_close(listen_fd);
		return;
	}

	if (zsock_listen(listen_fd, 1) < 0) {
		LOG_ERR("No se pudo poner el socket en escucha (errno=%d)", errno);
		zsock_close(listen_fd);
		return;
	}

	LOG_INF("Servidor TCP escuchando en el puerto %d", CONFIG_APP_TCP_PORT);

	for (;;) {
		LOG_INF("Esperando conexion de un cliente (la app de PC)...");

		struct sockaddr_in client_addr;
		socklen_t addr_len = sizeof(client_addr);

		int fd = zsock_accept(listen_fd, (struct sockaddr *)&client_addr, &addr_len);

		if (fd < 0) {
			LOG_ERR("accept() fallo (errno=%d)", errno);
			k_sleep(K_MSEC(1000));
			continue;
		}

		char addr_str[NET_IPV4_ADDR_LEN];

		net_addr_ntop(AF_INET, &client_addr.sin_addr, addr_str, sizeof(addr_str));
		LOG_INF("Cliente conectado desde %s:%d", addr_str, ntohs(client_addr.sin_port));

		set_client_fd(fd);

		bool client_connected = true;

		/* Bucle "notificador": usa poll() con timeout para detectar
		 * datos de forma asincrona (sin bloquear indefinidamente en
		 * un unico recv()), y en cuanto llegan, hace el traspaso
		 * minimo descrito arriba. */
		while (client_connected) {
			struct zsock_pollfd pfd = {
				.fd = fd,
				.events = ZSOCK_POLLIN,
			};

			int poll_ret = zsock_poll(&pfd, 1, POLL_TIMEOUT_MS);

			if (poll_ret < 0) {
				LOG_ERR("poll() fallo (errno=%d)", errno);
				break;
			}

			if (poll_ret == 0) {
				continue; /* timeout sin datos: vuelve a intentar */
			}

			if (pfd.revents & ZSOCK_POLLIN) {
				char chunk[RECV_CHUNK_SIZE];
				ssize_t n = zsock_recv(fd, chunk, sizeof(chunk), 0);

				if (n <= 0) {
					LOG_INF("Cliente desconectado");
					client_connected = false;
				} else {
					notify_data_available(chunk, (size_t)n);
				}
			}

			if (pfd.revents & (ZSOCK_POLLHUP | ZSOCK_POLLERR)) {
				LOG_INF("Conexion cerrada por el cliente");
				client_connected = false;
			}
		}

		set_client_fd(-1);
		zsock_close(fd);
	}
}

/* Se crea en estado suspendido (K_FOREVER como "delay" inicial) para que
 * el hilo NO intente usar la pila de red antes de que main() confirme que
 * la Wi-Fi ya tiene IP. tcp_server_start() lo arranca explícitamente. */
K_THREAD_DEFINE(tcp_server_tid, TCP_SERVER_STACK_SIZE, tcp_server_thread,
		 NULL, NULL, NULL, TCP_SERVER_PRIORITY, 0, -1);

void tcp_server_start(void)
{
	k_thread_start(tcp_server_tid);
}
```

## src/tcp_server.h
```c
#ifndef TCP_SERVER_H_
#define TCP_SERVER_H_

#include <stddef.h>
#include <stdbool.h>
#include <zephyr/kernel.h>

/**
 * Semáforo binario que cumple el rol de "interrupción" pedido en el
 * enunciado: se libera (k_sem_give) cada vez que el hilo notificador de
 * este módulo detecta y retira datos nuevos del socket TCP. La tarea de
 * procesamiento (rx_processor.c) se bloquea en k_sem_take() a la espera
 * de esta señal — nunca hace polling activo.
 *
 * Se declara con K_SEM_DEFINE a nivel de archivo en tcp_server.c, por lo
 * que ya está inicializado antes de que cualquier tarea arranque (no hay
 * condición de carrera posible con su uso vía extern aquí).
 */
extern struct k_sem tcp_server_rx_ready;

/**
 * @brief Arranca el hilo servidor TCP (creado suspendido con
 *        K_THREAD_DEFINE). Debe llamarse DESPUÉS de que la Wi-Fi tenga IP.
 *
 * Este hilo hace de "ISR de aplicación": escucha, acepta un cliente y, en
 * cuanto zsock_poll() indica datos disponibles, hace el trabajo MÍNIMO
 * (leerlos del socket y copiarlos a un buffer interno) antes de liberar
 * tcp_server_rx_ready. NO parsea JSON ni valida CRC — eso es responsabilidad
 * exclusiva de la tarea de procesamiento.
 */
void tcp_server_start(void);

/**
 * @brief Envía una trama ya construida (incluyendo el '\n' final) al
 *        cliente actualmente conectado, si lo hay. Usada por la tarea
 *        periódica de telemetría (telemetry_tx.c).
 *
 * @return true si había un cliente conectado y se intentó el envío;
 *         false si no hay ningún cliente conectado en este momento.
 */
bool tcp_server_send(const char *frame, size_t len);

/**
 * @brief Retira hasta dst_max bytes ya recibidos (y aún no consumidos)
 *        del buffer interno, en orden FIFO.
 *
 * Pensada para ser llamada EN BUCLE por la tarea de procesamiento
 * (rx_processor.c) tras despertar de tcp_server_rx_ready, hasta que
 * devuelva 0 (buffer vaciado). Es la única forma en que otro módulo toca
 * los datos crudos del socket: el acceso concurrente con el hilo
 * notificador está protegido internamente por un mutex, y la sección
 * crítica se mantiene deliberadamente corta.
 *
 * @return Número de bytes copiados a dst (puede ser 0).
 */
size_t tcp_server_drain_rx(char *dst, size_t dst_max);

#endif /* TCP_SERVER_H_ */
```

## src/telemetry_tx.c
```c
#include <zephyr/kernel.h>
#include <zephyr/logging/log.h>

#include "telemetry_tx.h"
#include "tcp_server.h"
#include "json_config.h"

LOG_MODULE_REGISTER(telemetry_tx, LOG_LEVEL_INF);

#define TX_STACK_SIZE 4096
#define TX_PRIORITY   5

static void telemetry_tx_thread_fn(void *p1, void *p2, void *p3)
{
	ARG_UNUSED(p1);
	ARG_UNUSED(p2);
	ARG_UNUSED(p3);

	uint32_t seq = 0;

	for (;;) {
		char frame[JSON_FRAME_MAX_LEN];
		int temp_simulada = 20 + (seq % 15);
		int hum_simulada = 50 + (seq % 20);

		// 2. Comando: struct datos_tx tx_datos = {...}
		// El porqué: Llena la estructura de datos agnóstica a JSON definida en json_config.h
		// La comunicación: Manejo de datos interno para telemetría.
		// Los parámetros: Variables simuladas.
		struct datos_tx tx_datos = {
			.id_dispositivo = 101,
			.temperatura = temp_simulada,
			.humedad = hum_simulada,
			.crc = 0 // Se calcula abajo
		};

		// 3. Comando: calculate_crc_tx
		// El porqué: Sella matemáticamente los datos usando el algoritmo XOR acumulativo.
		tx_datos.crc = calculate_crc_tx(&tx_datos);

		// 4. Comando: json_calc_encoded_len & json_obj_encode_buf
		// El porqué: Convierte nativamente el struct C a un JSON válido usando <data/json.h>.
		ssize_t frame_len = json_calc_encoded_len(tx_descr, tx_descr_len, &tx_datos);

		if (frame_len > 0 && frame_len < sizeof(frame) - 2) {
			json_obj_encode_buf(tx_descr, tx_descr_len, &tx_datos, frame, sizeof(frame));
			
			frame[frame_len] = '\n';
			frame[frame_len + 1] = '\0';
			frame_len++;

			if (!tcp_server_send(frame, (size_t)frame_len)) {
				LOG_DBG("Sin cliente conectado: telemetria no enviada");
			}
		}

		seq++;
		k_msleep(CONFIG_APP_TELEMETRY_PERIOD_MS);
	}
}

K_THREAD_DEFINE(telemetry_tx_tid, TX_STACK_SIZE, telemetry_tx_thread_fn,
		 NULL, NULL, NULL, TX_PRIORITY, 0, -1);

void telemetry_tx_start(void)
{
	k_thread_start(telemetry_tx_tid);
}
```

## src/wifi_manager.c
```c
#include <string.h>
#include <errno.h>

#include <zephyr/kernel.h>
#include <zephyr/logging/log.h>
#include <zephyr/net/net_if.h>
#include <zephyr/net/net_ip.h>
#include <zephyr/net/net_mgmt.h>
#include <zephyr/net/wifi_mgmt.h>
#include <zephyr/net/dhcpv4.h>

#include "wifi_manager.h"

LOG_MODULE_REGISTER(wifi_manager, LOG_LEVEL_INF);

/* Eventos del stack de red que nos interesan. Se atienden con callbacks
 * asíncronos (net_mgmt), nunca sondeando el estado en un bucle. */
#define WIFI_MGMT_EVENTS (NET_EVENT_WIFI_CONNECT_RESULT | NET_EVENT_WIFI_DISCONNECT_RESULT)
#define IPV4_MGMT_EVENTS (NET_EVENT_IPV4_ADDR_ADD)

static struct net_mgmt_event_callback wifi_cb;
static struct net_mgmt_event_callback ipv4_cb;
static struct k_sem got_ip_sem;

static void wifi_mgmt_event_handler(struct net_mgmt_event_callback *cb,
				     uint64_t mgmt_event, struct net_if *iface)
{
	switch (mgmt_event) {
	case NET_EVENT_WIFI_CONNECT_RESULT: {
		const struct wifi_status *status = (const struct wifi_status *)cb->info;

		if (status != NULL && status->status) {
			LOG_ERR("Fallo al conectar a la red Wi-Fi (status=%d)", status->status);
			break;
		}

		LOG_INF("Wi-Fi asociada correctamente, iniciando cliente DHCP...");
		net_dhcpv4_start(iface);
		break;
	}
	case NET_EVENT_WIFI_DISCONNECT_RESULT:
		LOG_WRN("Wi-Fi desconectada");
		break;
	default:
		break;
	}
}

static void ipv4_mgmt_event_handler(struct net_mgmt_event_callback *cb,
				     uint64_t mgmt_event, struct net_if *iface)
{
	ARG_UNUSED(cb);

	if (mgmt_event != NET_EVENT_IPV4_ADDR_ADD) {
		return;
	}

	char buf[NET_IPV4_ADDR_LEN];
	const struct in_addr *addr = &iface->config.ip.ipv4->unicast[0].ipv4.address.in_addr;

	net_addr_ntop(AF_INET, addr, buf, sizeof(buf));
	LOG_INF("Direccion IP obtenida por DHCP: %s  <-- usa esta IP en main.py de la PC", buf);

	k_sem_give(&got_ip_sem);
}

int wifi_manager_connect(void)
{
	struct net_if *iface = net_if_get_default();

	if (iface == NULL) {
		LOG_ERR("No se encontro una interfaz de red por defecto");
		return -ENODEV;
	}

	k_sem_init(&got_ip_sem, 0, 1);

	net_mgmt_init_event_callback(&wifi_cb, wifi_mgmt_event_handler, WIFI_MGMT_EVENTS);
	net_mgmt_add_event_callback(&wifi_cb);

	net_mgmt_init_event_callback(&ipv4_cb, ipv4_mgmt_event_handler, IPV4_MGMT_EVENTS);
	net_mgmt_add_event_callback(&ipv4_cb);

	struct wifi_connect_req_params params = {
		.ssid = (const uint8_t *)CONFIG_APP_WIFI_SSID,
		.ssid_length = strlen(CONFIG_APP_WIFI_SSID),
		.psk = (const uint8_t *)CONFIG_APP_WIFI_PSK,
		.psk_length = strlen(CONFIG_APP_WIFI_PSK),
		.security = WIFI_SECURITY_TYPE_PSK,
		.channel = WIFI_CHANNEL_ANY,
		.band = WIFI_FREQ_BAND_2_4_GHZ,
	};

	LOG_INF("Conectando a la red Wi-Fi \"%s\"...", CONFIG_APP_WIFI_SSID);

	int ret = net_mgmt(NET_REQUEST_WIFI_CONNECT, iface, &params, sizeof(params));

	if (ret) {
		LOG_ERR("net_mgmt(NET_REQUEST_WIFI_CONNECT) fallo: %d", ret);
		return ret;
	}

	/* Bloquea SIN ocupar CPU (no es un busy-wait) hasta que el callback
	 * de IPv4 confirme que ya hay una direccion asignada por DHCP. */
	if (k_sem_take(&got_ip_sem, K_SECONDS(30)) != 0) {
		LOG_ERR("Tiempo de espera agotado esperando IP por DHCP");
		return -ETIMEDOUT;
	}

	return 0;
}
```
